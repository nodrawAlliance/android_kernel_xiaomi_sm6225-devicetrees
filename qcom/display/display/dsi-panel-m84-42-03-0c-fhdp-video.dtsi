&mdss_mdp {
    dsi_panel_m84_42_03_0c_fhdp_video: qcom,mdss_dsi_panel_m84_42_03_0c_fhdp_video {
        qcom,ulps-enabled;
        qcom,platform-reset-gpio-always-on;
        qcom,mdss-pan-physical-height-dimension = <0x936>;
        qcom,mdss-pan-physical-width-dimension = <0x5c2>;
        qcom,dsi-supported-dfps-list = <0x5a 0x3c 0x32 0x30 0x1e>;
        qcom,mdss-dsi-pan-fps-update = "dfps_immediate_porch_mode_vfp";
        qcom,mdss-dsi-pan-enable-dynamic-fps;
        qcom,esd-err-irq-gpio-m = <&tlmm 36 0x2002>;
        qcom,mdss-dsi-reset-sequence = <0x01 0x0a 0x00 0x0a 0x01 0x0f>;
        qcom,mdss-dsi-bl-move-high-8b;
        qcom,mdss-dsi-bl-inverted-dbv;
        qcom,mdss-brightness-max-level = <0x7ff>;
        qcom,dispparam-enabled;
        qcom,mdss-dsi-lp11-init;
        qcom,mdss-dsi-mdp-trigger = "none";
        qcom,mdss-dsi-dma-trigger = "trigger_sw";
        qcom,mdss-dsi-lane-3-state;
        qcom,mdss-dsi-lane-2-state;
        qcom,mdss-dsi-lane-1-state;
        qcom,mdss-dsi-lane-0-state;
        qcom,mdss-dsi-tx-eot-append;
        qcom,mdss-dsi-bllp-power-mode;
        qcom,mdss-dsi-bllp-eof-power-mode;
        qcom,mdss-dsi-lane-map = "lane_map_0123";
        qcom,mdss-dsi-traffic-mode = "non_burst_sync_event";
        qcom,mdss-dsi-h-sync-pulse = <0x00>;
        qcom,mdss-dsi-border-color = <0x00>;
        qcom,mdss-dsi-underflow-color = <0xff>;
        qcom,mdss-dsi-color-order = "rgb_swap_rgb";
        qcom,mdss-dsi-bpp = <0x18>;
        qcom,mdss-dsi-v-bottom-border = <0x00>;
        qcom,mdss-dsi-v-top-border = <0x00>;
        qcom,mdss-dsi-h-right-border = <0x00>;
        qcom,mdss-dsi-h-left-border = <0x00>;
        qcom,mdss-dsi-stream = <0x00>;
        qcom,mdss-dsi-virtual-channel-id = <0x00>;
        qcom,dsi-phy-num = <0x00>;
        qcom,dsi-ctrl-num = <0x00>;
        qcom,mdss-dsi-panel-type = "dsi_video_mode";
        qcom,mdss-dsi-panel-name = "m84 42 03 0c video mode fhdp dsi panel";

        qcom,mdss-dsi-display-timings {
            timing@0 {;
                qcom,mdss-dsc-block-prediction-enable;
                qcom,mdss-dsc-bit-per-pixel = <0x08>;
                qcom,mdss-dsc-bit-per-component = <0x08>;
                qcom,mdss-dsc-slice-per-pkt = <0x02>;
                qcom,mdss-dsc-slice-width = <0x258>;
                qcom,mdss-dsc-slice-height = <0x28>;
                qcom,mdss-dsc-scr-version = <0x00>;
                qcom,mdss-dsc-version = <0x11>;
                qcom,compression-mode = "dsc";
                mi,mdss-dsi-hbm-off-command-state = "dsi_lp_mode";
                mi,mdss-dsi-hbm-on-command-state = "dsi_lp_mode";
                qcom,mdss-dsi-dispparam-cabc-off-command-status = "dsi_lp_mode";
                qcom,mdss-dsi-dispparam-cabc-movice-on-command-status = "dsi_lp_mode";
                qcom,mdss-dsi-dispparam-cabc-still-on-command-status = "dsi_lp_mode";
                qcom,mdss-dsi-dispparam-cabc-ui-on-command-status = "dsi_lp_mode";
                qcom,mdss-dsi-dispparam-fps-30hz-command-state = "dsi_hs_mode";
                qcom,mdss-dsi-dispparam-fps-48hz-command-state = "dsi_hs_mode";
                qcom,mdss-dsi-dispparam-fps-50hz-command-state = "dsi_hs_mode";
                qcom,mdss-dsi-dispparam-fps-60hz-command-state = "dsi_hs_mode";
                qcom,mdss-dsi-dispparam-fps-90hz-command-state = "dsi_hs_mode";
                qcom,mdss-dsi-off-command-state = "dsi_lp_mode";
                qcom,mdss-dsi-on-command-state = "dsi_lp_mode";
                mi,mdss-dsi-hbm-off-command = [
                    39 01 00 00 00 00 02 00 00
                    39 01 00 00 00 00 04 ff 82 01 01
                    39 01 00 00 00 00 02 00 80
                    39 01 00 00 00 00 03 ff 82 01
                    39 01 00 00 00 00 02 00 b4
                    39 01 00 00 00 00 02 ca 06
                    39 01 00 00 00 00 03 51 e6 04
                ];
                mi,mdss-dsi-hbm-on-command = [
                    39 01 00 00 00 00 03 51 ff 0e
                ];
                qcom,mdss-dsi-dispparam-cabc-off-command = [
                    39 01 00 00 00 00 02 55 00
                ];
                qcom,mdss-dsi-dispparam-cabc-movice-on-command = [
                    39 01 00 00 00 00 02 55 03
                ];
                qcom,mdss-dsi-dispparam-cabc-still-on-command = [
                    39 01 00 00 00 00 02 55 02
                ];
                qcom,mdss-dsi-dispparam-cabc-ui-on-command = [
                    39 01 00 00 00 00 02 55 01
                ];
                qcom,mdss-dsi-dispparam-fps-30hz-command = [
                    39 00 00 40 00 00 02 00 00
                    39 00 00 00 00 00 02 1c 81
                ];
                qcom,mdss-dsi-dispparam-fps-48hz-command = [
                    39 00 00 40 00 00 02 00 00
                    39 00 00 00 00 00 02 1c 61
                ];
                qcom,mdss-dsi-dispparam-fps-50hz-command = [
                    39 00 00 40 00 00 02 00 00
                    39 00 00 00 00 00 02 1c 41
                ];
                qcom,mdss-dsi-dispparam-fps-60hz-command = [
                    39 00 00 40 00 00 02 00 00
                    39 00 00 00 00 00 02 1c 21
                ];
                qcom,mdss-dsi-dispparam-fps-90hz-command = [
                    39 00 00 40 00 00 02 00 00
                    39 00 00 00 00 00 02 1c 01
                ];
                qcom,mdss-dsi-off-command = [
                    15 01 00 00 14 00 02 28 00
                    15 01 00 00 78 00 02 10 00
                    39 01 00 00 00 00 02 00 00
                    39 01 00 00 00 00 05 f7 5a a5 95 27
                ];
                qcom,mdss-dsi-on-command = [
                    39 01 00 00 00 00 02 00 00
                    39 01 00 00 00 00 04 ff 82 01 01
                    39 01 00 00 00 00 02 00 80
                    39 01 00 00 00 00 03 ff 82 01
                    39 01 00 00 00 00 02 00 b0
                    39 01 00 00 00 00 04 ca 01 01 04
                    39 01 00 00 00 00 02 00 b4
                    39 01 00 00 00 00 02 ca 02
                    39 01 00 00 00 00 02 00 a0
                    39 01 00 00 00 00 04 ca 08 08 08
                    39 01 00 00 00 00 02 00 80
                    39 01 00 00 00 00 0d ca eb d7 c3 b6 ad 9a 9a 93 8e 8c 88 83
                    39 01 00 00 00 00 02 00 90
                    39 01 00 00 00 00 0a ca fe ff 66 f5 ff 99 fa ff 65
                    39 01 00 00 00 00 02 00 be
                    39 01 00 00 00 00 02 b4 20
                    39 01 00 00 00 00 02 00 a4
                    39 01 00 00 00 00 02 f3 0b
                    39 01 00 00 00 00 02 00 00
                    39 01 00 00 00 00 02 fa 01
                    39 01 00 00 00 00 02 00 91
                    39 01 00 00 00 00 02 a5 40
                    39 01 00 00 00 00 02 00 a4
                    39 01 00 00 00 00 02 f3 0b
                    39 01 00 00 00 00 02 00 00
                    39 01 00 00 00 00 02 fa 5a
                    39 01 00 00 00 00 02 00 80
                    39 01 00 00 00 00 02 c4 30
                    39 01 00 00 00 00 02 00 00
                    39 01 00 00 00 00 04 ff 00 00 00
                    39 01 00 00 00 00 02 00 80
                    39 01 00 00 00 00 03 ff 00 00
                    39 01 00 00 00 00 03 51 e6 04
                    39 01 00 00 00 00 02 53 2c
                    39 01 00 00 0a 00 02 55 03
                    05 01 00 00 78 00 01 11
                    05 01 00 00 14 00 01 29
                    39 01 00 00 00 00 03 5e 01 04
                    39 01 00 00 00 00 02 35 00
                    39 01 00 00 00 00 02 00 00
                    39 01 00 00 00 00 02 1c 01
                ];
                qcom,mdss-dsi-panel-framerate = <0x5a>;
                qcom,mdss-dsi-v-front-porch = <0x19a>;
                qcom,mdss-dsi-v-back-porch = <0x0a>;
                qcom,mdss-dsi-v-pulse-width = <0x06>;
                qcom,mdss-dsi-h-sync-skew = <0x00>;
                qcom,mdss-dsi-h-front-porch = <0x32>;
                qcom,mdss-dsi-h-back-porch = <0x24>;
                qcom,mdss-dsi-h-pulse-width = <0x14>;
                qcom,mdss-dsi-panel-height = <0x780>;
                qcom,mdss-dsi-panel-width = <0x4b0>;
            };
        };
    };
};
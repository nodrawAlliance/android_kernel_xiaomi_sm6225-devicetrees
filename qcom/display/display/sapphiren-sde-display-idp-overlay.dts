/dts-v1/;
/plugin/;

#include "sapphiren-sde-display-idp.dtsi"

/ {
	model = "Qualcomm Technologies, Inc. Khaje IDP sapphire";
	compatible = "qcom,khaje-idp", "qcom,khaje", "qcom,idp";
	qcom,msm-id = <586 0x10000>, <518 0x10000>;
	qcom,board-id = <0x30022 0x00>;
	qcom,pmic-id = <0x2D 0x2E 0x00 0x00>;
};

&qupv3_se4_i2c {
	status = "ok";
	qcom,clk-freq-out = <400000>;
	#address-cells = <1>;
	#size-cells = <0>;

    st_st21nfc@08 {
        compatible = "st,st21nfc";
        reg = <0x08>;
        st,irq-gpio = <&tlmm 70 0>;
        st,reset-gpio = <&tlmm 69 0>;
        st,clkreq-gpio = <&tlmm 71 0>;
        interrupt-parent = <&tlmm>;
        interrupts = <70 0>;
        interrupt-names = "nfc_irq";
        clock-names = "nfc_ref_clk";
        st,clk_pinctrl;
    };
};
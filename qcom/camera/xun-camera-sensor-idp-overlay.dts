/dts-v1/;
/plugin/;

#include <dt-bindings/clock/qcom,gcc-khaje.h>
#include "xun-camera-sensor-idp.dtsi"

/ {
	model = "Qualcomm Technologies, Inc. KHAJE IDP nopmi xun";
	compatible = "qcom,khaje-idp", "qcom,khaje", "qcom,idp";
	qcom,msm-id = <518 0x10000>, <586 0x10000>;
	qcom,board-id = <0x20022 0x00>;
	qcom,pmic-id = <0x2d 0x00 0x00 0x00>;
};
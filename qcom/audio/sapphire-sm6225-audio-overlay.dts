/dts-v1/;
/plugin/;

#include "bengal-audio-overlay.dtsi"
#include "sapphiren-sm6225-audio.dtsi"

/ {
	model = "Qualcomm Technologies, Inc. Khaje IDP sapphire";
	compatible = "qcom,khaje-idp", "qcom,khaje", "qcom,idp";
	qcom,msm-id = <0x24A 0x10000 0x206 0x10000>;
	qcom,board-id = <0x20022 0>;
	qcom,pmic-id = <0x2D 0x2E 0x0 0x0>;
};
